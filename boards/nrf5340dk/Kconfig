## boards/nrf5340dk/Kconfig
```kconfig
# Copyright (c) 2023 Mesotic SAS
#
# This file is subject to the terms and conditions of the GNU Lesser
# General Public License v2.1. See the file LICENSE in the top level
# directory for more details.

config BOARD
    default "nrf5340dk" if BOARD_NRF5340DK

config BOARD_NRF5340DK
    bool
    default y
    select CPU_MODEL_NRF5340
    select HAS_PERIPH_TIMER
    select HAS_PERIPH_UART
    select HAS_PERIPH_UART_HW_FC

    # Put other features for this board (in alphabetical order)
```

## pkg/nrf_modem/Kconfig
```kconfig
# Copyright (c) 2021 Mesotic SAS
#
# This file is subject to the terms and conditions of the GNU Lesser
# General Public License v2.1. See the file LICENSE in the top level
# directory for more details.
#

config PACKAGE_NRF_MODEM
    bool "nRF Modem LTE for nRF9160"
    depends on TEST_KCONFIG
    help
        nRF Modem library allows to use the nRF9160 modem to use
        NB-IoT, LTE-M or GNSS features with this MCU
```
